## config/boards/shields/dactylmanuform/Kconfig.defconfig
```kconfig
if SHIELD_DACTYLMANUFORM_LEFT

config ZMK_KEYBOARD_NAME
    default "Dactyl Manuform"

config ZMK_SPLIT_BLE_ROLE_CENTRAL
    default y

endif

if SHIELD_DACTYLMANUFORM_LEFT || SHIELD_DACTYLMANUFORM_RIGHT

config ZMK_SPLIT
    default y

endif
```
